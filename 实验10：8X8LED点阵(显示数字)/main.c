/**************************************************************************************
*		              8*8LED点阵———显示数字实验												  *
实现现象：下载程序后点阵上显示数字0
			
注意事项：一定要将JOE短接片短接到GND端，如果不需要595后面的小灯点亮可以拔掉JP595短接片。																				  
***************************************************************************************/

#include "reg51.h"			 //此文件中定义了单片机的一些特殊功能寄存器
#include<intrins.h>

typedef unsigned int u16;	  //对数据类型进行声明定义
typedef unsigned char u8;

char receiveData[16];

u8 ReceiveCount=0;

void UsartInit()
{
	SCON=0X50;			//设置为工作方式1
	TMOD=0X20;			//设置计数器工作方式2
	PCON=0X80;			//波特率加倍
	TH1=0XF3;				//计数器初始值设置，注意波特率是4800的
	TL1=0XF3;
	ES=1;						//打开接收中断
	EA=1;						//打开总中断
	TR1=1;					//打开计数器
}

/*******************************************************************************
* 函数名         : Usart() interrupt 4
* 函数功能		  : 串口通信中断函数
* 输入           : 无
* 输出         	 : 无
*******************************************************************************/
void Usart() interrupt 4
{
	receiveData[ReceiveCount++] = SBUF;//出去接收到的数据
	if(ReceiveCount >= 8)
	{
		ReceiveCount = 0; 
	}

	RI = 0;//清除接收中断标志位
	//SBUF=receiveData;//将接收到的数据放入到发送寄存器
	//while(!TI);			 //等待发送数据完成
	TI=0;						 //清除发送完成标志位
}




sbit SRCLK=P3^6;
sbit RCLK=P3^5;
sbit SER=P3^4;


/*******************************************************************************
* 函 数 名         : delay
* 函数功能		   : 延时函数，i=1时，大约延时10us
*******************************************************************************/
void delay(u16 i)
{
	while(i--);	
}
void Delay100ms()		//@12.000MHz
{
	unsigned char i, j;

	i = 195;
	j = 138;
	do
	{
		while (--j);
	} while (--i);
}

/*******************************************************************************
* 函数名         : Hc595SendByte(u8 dat)
* 函数功能		   : 向74HC595发送一个字节的数据
* 输入           : 无
* 输出         	 : 无
*******************************************************************************/
void Hc595SendByte(unsigned char dat)
{
	u8 a;
	SRCLK=0;
	RCLK=0;
	for(a=0;a<8;a++)
	{
		SER=dat&(0x80>>a);

		SRCLK=1;
		SRCLK=0;	
	}

	RCLK=1;
	RCLK=0;
}

void MatrixLED_ShowColumn(unsigned char Column,Data){
	Hc595SendByte(Data);
	P0=~(0x80>>Column);
	delay(100);
	//_nop_();
	//_nop_();
	P0=0xFF;
}
/*******************************************************************************
* 函 数 名       : main
* 函数功能		 : 主函数
* 输    入       : 无
* 输    出    	 : 无
*******************************************************************************/
u8 a,counts=0;
void main()
{	
		
	UsartInit();
	while(1)
	{
		for(a=0;a<8;a++){
			MatrixLED_ShowColumn(a,receiveData[a]);
		}			
	}		
}
